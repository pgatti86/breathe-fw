## main/Kconfig.projbuild
```kconfig
menu "Breathe config"

config BROKER_URL
    string "Broker URL"
    default "mqtts://breathe.gatti.dev:8883"
    help
        URL of the broker to connect to

config SNTP_SERVER
    string "SNTP server"
    default "pool.ntp.org"
    help
        SNTP server

config DHT_GPIO
    int "DHT GPIO"
    default 21
    help
        GPIO connected to DHT sensor

config FW_UPDATE_URL
    string "Firmware update URL"
    default "https://breathe.gatti.dev/fw/latest"
    help
        URL of the latest available firmware        

endmenu
```
